/dts-v1/;
/plugin/;

/ {
    fragment@0 {
        target-path = "/soc/a55_apb0/i2c@341c0000";
        __overlay__ {
            #address-cells = <1>;
            #size-cells = <0>;

            gt911@5d {
                compatible = "goodix,gt911";
                reg = <0x5d>;
                interrupt-parent = <&dsp_gpio_porta>;
                interrupts = <9 2>;
                reset-gpios = <&ls_gpio1_porta 7 1>;

                touchscreen-size-x = <320>;
                touchscreen-size-y = <480>;
            };
        };
    };
};
