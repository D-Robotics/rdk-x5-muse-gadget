/dts-v1/;
/plugin/;

/ {
    fragment@0 {
        target-path = "/soc/a55_apb0/spi@34010000";
        __overlay__ {
            #address-cells = <1>;
            #size-cells = <0>;

            spidev@1 {
                status = "disabled";
            };

            panel-mipi-dbi@1 {
                compatible = "panel-mipi-dbi-spi";
                reg = <1>;
                spi-max-frequency = <40000000>;
                dc-gpios = <&ls_gpio0_porta 9 0>;
                reset-gpios = <&ls_gpio0_porta 0 0>;
                write-only;

                width-mm = <74>;
                height-mm = <49>;

                panel-timing {
                    clock-frequency = <0>;
                    hactive = <480>;
                    vactive = <320>;
                    hfront-porch = <0>;
                    hsync-len = <0>;
                    hback-porch = <0>;
                    vfront-porch = <0>;
                    vsync-len = <0>;
                    vback-porch = <0>;
                };
            };
        };
    };
};
